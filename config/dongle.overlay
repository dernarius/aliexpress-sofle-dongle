#include "eyelash_sofle.dtsi" 

/ {
    chosen {
        zmk,kscan = &mock_kscan;
        
        // This references the transform that was just imported above
        zmk,matrix-transform = &default_transform; 
    };

    mock_kscan: mock_kscan_0 {
        compatible = "zmk,kscan-mock";
        columns = <0>;
        rows = <0>;
        events = <0>;
    };
};
